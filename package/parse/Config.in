## package/parse/Config.in
```kconfig
config BR2_PACKAGE_PARSE
	bool "parse"
	select BR2_PACKAGE_OPENSSL
	select BR2_PACKAGE_LIBCURL
	select BR2_PACKAGE_UTIL_LINUX
	select BR2_PACKAGE_UTIL_LINUX_UUIDD
	help
	Parse is a developer-friendly cloud platform 
	that lets you get an IoT project running in 
	minutes. Parse Embedded C SDKs provide support 
	for Arduino Yún, Unix, and RTOS C platforms.
	These SDKs let you use Parse for building Internet 
	of Things (IoT) applications with connected devices.

	https://github.com/parse-community/parse-embedded-sdks
```
